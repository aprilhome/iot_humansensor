## board/Kconfig
```kconfig
menu "Hardware Drivers Config"

config SOC_STM32L475RG
    bool
    select SOC_SERIES_STM32L4
    default y

menu "Onboard Peripheral Drivers"

    config BSP_USING_STLINK_TO_USART
        bool "Enable STLINK TO USART (uart1)"
        select BSP_USING_UART
        select BSP_USING_UART1
        default y

    config BSP_USING_QSPI_FLASH
        bool "Enable QSPI FLASH (W25Q128 qspi1)"
        select BSP_USING_QSPI
        select RT_USING_SFUD
        select RT_SFUD_USING_QSPI
        default n

    config BSP_USING_SDCARD
        bool "Enable SDCARD (spi1)"
        select BSP_USING_SPI
        select BSP_USING_SPI1
        select RT_USING_SPI_MSD
        select RT_USING_DFS
        select RT_USING_DFS_ELMFAT
        default n

    config BSP_USING_ICM20608
        bool "Enable icm20608 (i2c3)"
        select BSP_USING_I2C
        select BSP_USING_I2C3
        select PKG_USING_SENSORS_DRIVERS
        select PKG_USING_MPU6XXX
        select PKG_USING_MPU6XXX_LATEST_VERSION
        default n
        
    config BSP_USING_AHT10
        bool "Enable aht10 (i2c4)"
        select BSP_USING_I2C
        select BSP_USING_I2C4
        select PKG_USING_SENSORS_DRIVERS
        select PKG_USING_AHT10
        select PKG_USING_AHT10_LATEST_VERSION
        default n

endmenu

menu "On-chip Peripheral Drivers"

    config BSP_USING_GPIO
        bool "Enable GPIO"
        select RT_USING_PIN
        default y

    menuconfig BSP_USING_UART
        bool "Enable UART"
        default y
        select RT_USING_SERIAL
        if BSP_USING_UART
            config BSP_USING_UART1
                bool "Enable UART1"
                default n

            config BSP_UART1_RX_USING_DMA
                bool "Enable UART1 RX DMA"
                depends on BSP_USING_UART1 && RT_SERIAL_USING_DMA
                default n

            config BSP_USING_UART2
                bool "Enable UART2"
                default n

            config BSP_UART2_RX_USING_DMA
                bool "Enable UART2 RX DMA"
                depends on BSP_USING_UART2 && RT_SERIAL_USING_DMA
                default n
				
			config BSP_USING_UART3
                bool "Enable UART3"
                default n

            config BSP_UART3_RX_USING_DMA
                bool "Enable UART3 RX DMA"
                depends on BSP_USING_UART3 && RT_SERIAL_USING_DMA
                default n
			
			config BSP_USING_UART4
                bool "Enable UART4"
                default n

            config BSP_UART4_RX_USING_DMA
                bool "Enable UART4 RX DMA"
                depends on BSP_USING_UART4 && RT_SERIAL_USING_DMA
                default n	
				
			config BSP_USING_UART5
                bool "Enable UART5"
                default n

            config BSP_UART5_RX_USING_DMA
                bool "Enable UART5 RX DMA"
                depends on BSP_USING_UART5 && RT_SERIAL_USING_DMA
                default n	
				
			config BSP_USING_LPUART1
                bool "Enable LPUART1"
                default y

            config BSP_LPUART1_RX_USING_DMA
                bool "Enable LPUART1 RX DMA"
                depends on BSP_USING_LPUART1 && RT_SERIAL_USING_DMA
                default n			
        endif

    config BSP_USING_ON_CHIP_FLASH
        bool "Enable on-chip FLASH"
        default n

    menuconfig BSP_USING_SPI
        bool "Enable SPI BUS"
        default n
        select RT_USING_SPI
        if BSP_USING_SPI
            config BSP_USING_SPI1
                bool "Enable SPI1 BUS"
                default n

            config BSP_SPI1_TX_USING_DMA
                bool "Enable SPI1 TX DMA"
                depends on BSP_USING_SPI1
                default n
                
            config BSP_SPI1_RX_USING_DMA
                bool "Enable SPI1 RX DMA"
                depends on BSP_USING_SPI1
                select BSP_SPI1_TX_USING_DMA
                default n

            config BSP_USING_SPI2
                bool "Enable SPI2 BUS"
                default n  
                
            config BSP_SPI2_TX_USING_DMA
                bool "Enable SPI2 TX DMA"
                depends on BSP_USING_SPI2
                default n
                
            config BSP_SPI2_RX_USING_DMA
                bool "Enable SPI2 RX DMA"
                depends on BSP_USING_SPI2
                select BSP_SPI2_TX_USING_DMA
                default n
        endif

    config BSP_USING_QSPI
        bool "Enable QSPI BUS"
        select RT_USING_QSPI
        select RT_USING_SPI
        default n

    config BSP_QSPI_USING_DMA
        bool "Enable QSPI DMA support"
        default n

    menuconfig BSP_USING_I2C
        bool "Enable I2C BUS"
        default n
        select RT_USING_I2C
        select RT_USING_I2C_BITOPS
        select RT_USING_PIN
        if BSP_USING_I2C
		    menuconfig BSP_USING_I2C1
                bool "Enable I2C1 BUS (RTC)"
                default y
                if BSP_USING_I2C1
                    comment "Notice: PB6 --> 22; PB7 --> 23" 
                    config BSP_I2C1_SCL_PIN
                        int "i2c1 scl pin number"
                        range 1 176
                        default 22
                    config BSP_I2C1_SDA_PIN
                        int "i2c1 sda pin number"
                        range 1 176
                        default 23
                endif
				
			menuconfig BSP_USING_I2C2
                bool "Enable I2C2 BUS"
                default y
                if BSP_USING_I2C2
                    comment "Notice: PC8 --> 40; PC9 --> 41" 
                    config BSP_I2C2_SCL_PIN
                        int "i2c2 scl pin number"
                        range 1 176
                        default 40
                    config BSP_I2C2_SDA_PIN
                        int "I2C2 sda pin number"
                        range 1 176
                        default 41
                endif	
				
            menuconfig BSP_USING_I2C3
                bool "Enable I2C3 BUS"
                default y
                if BSP_USING_I2C3
                    comment "Notice: PC11 --> 43; PC10 --> 42" 
                    config BSP_I2C3_SCL_PIN
                        int "i2c3 scl pin number"
                        range 1 176
                        default 43
                    config BSP_I2C3_SDA_PIN
                        int "I2C3 sda pin number"
                        range 1 176
                        default 42
                endif

            menuconfig BSP_USING_I2C4
                bool "Enable I2C4 BUS (soft)"
                default n
                if BSP_USING_I2C4
                    comment "Notice: PC1 --> 33; PD6 --> 54" 
                    config BSP_I2C4_SCL_PIN
                        int "i2c4 scl pin number"
                        range 1 176
                        default 54
                    config BSP_I2C4_SDA_PIN
                        int "I2C4 sda pin number"
                        range 1 176
                        default 33
                endif
        endif

    menuconfig BSP_USING_TIM
        bool "Enable timer"
        default n
        select RT_USING_HWTIMER
        if BSP_USING_TIM	
            config BSP_USING_TIM15
                bool "Enable TIM15"
                default n

            config BSP_USING_TIM16
                bool "Enable TIM16"
                default n

            config BSP_USING_TIM17
                bool "Enable TIM17"
                default n
        endif
		
	menuconfig BSP_USING_LPTIM
		bool "Enable lptimer"
        default n
        select RT_USING_LPTIMER
		if BSP_USING_LPTIM
		config BSP_USING_LPTIM1
                bool "Enable LPTIM1"
                default n
		endif

    menuconfig BSP_USING_PWM
        bool "Enable pwm"
        default n
        select RT_USING_PWM
        if BSP_USING_PWM
        menuconfig BSP_USING_PWM1
            bool "Enable timer1 output pwm"
            default n
            if BSP_USING_PWM1
                config BSP_USING_PWM1_CH1
                    bool "Enable PWM1 channel1"
                    default n
            endif
        menuconfig BSP_USING_PWM4
            bool "Enable timer4 output pwm"
            default n
            if BSP_USING_PWM4
                config BSP_USING_PWM4_CH2
                    bool "Enable PWM4 channel2"
                    default n
            
                config BSP_USING_PWM4_CH3
                    bool "Enable PWM4 channel3"
                    default n
					
				config BSP_USING_PWM4_CH4
                    bool "Enable PWM4 channel4"
                    default n	
            endif
        endif

    menuconfig BSP_USING_ADC
        bool "Enable ADC"
        default n
        select RT_USING_ADC
        if BSP_USING_ADC
            config BSP_USING_ADC1
                bool "Enable ADC1"
                default n
        endif

    menuconfig BSP_USING_ONCHIP_RTC
        bool "Enable RTC"
        select RT_USING_RTC
        select RT_USING_LIBC
        default n
        if BSP_USING_ONCHIP_RTC
            choice
                prompt "Select clock source"
                default BSP_RTC_USING_LSE

                config BSP_RTC_USING_LSE
                    bool "RTC USING LSE"

                config BSP_RTC_USING_LSI
                    bool "RTC USING LSI"
            endchoice
        endif

    config BSP_USING_WDT
        bool "Enable Watchdog Timer"
        select RT_USING_WDT
        default n

endmenu

menu "Board extended module Drivers"

endmenu

endmenu
```
